## sdkconfig.defaults
```kconfig
# Needed to route AP-client traffic over the STA uplink (router/NAT function)
CONFIG_LWIP_IP_FORWARD=y
CONFIG_LWIP_IPV4_NAPT=y
CONFIG_LWIP_L2_TO_L3_COPY=y

# Larger app partition (WiFi + httpd + led_strip does not always fit in the default 1 MB)
CONFIG_PARTITION_TABLE_SINGLE_APP_LARGE=y
```
